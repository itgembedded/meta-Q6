## conf/machine/jciq6.conf
```bitbake
#@TYPE: Machine
#@NAME: JCI Q6 Board
#@SOC: i.MX6Q
#@DESCRIPTION: Machine configuration for JCI Q6 Board
#@MAINTAINER: Phil FLournoy <phil@itgembedded.com>

require conf/machine/include/Q6-common.inc

SOC_FAMILY = "mx6:mx6q"

PREFERRED_PROVIDER_u-boot_mx6 = "u-boot-Q6"
PREFERRED_PROVIDER_virtual/kernel_mx6 = "linux-Q6"
PREFERRED_VERSION_linux-Q6 ?= "3.14"

KERNEL_DEVICETREE = "imx6q-Q6.dtb" 

UBOOT_CONFIG ??= "sd"
UBOOT_CONFIG[sd] = "Q6_config,sdcard"
UBOOT_CONFIG[sata] = "Q6_sata_config"
UBOOT_CONFIG[mfgtool] = "Q6_config"
```
